## kernel-3.18/drivers/arima/Kconfig
```kconfig
# +++++ [Arima 5556] 20160909 Add Hw version By  Edwin
menuconfig ARIMA
	bool "Arima information"
	help
	  Show arima information

if ARIMA

menu "Arima Hardware Version"

source "drivers/arima/hwVersion/Kconfig"

endmenu

endif #ARIMA 
   
# ----- [Arima 5556] 20160909 Add Hw version By  Edwin
```

## kernel-3.18/drivers/arima/hwVersion/Kconfig
```kconfig
# +++++ [Arima 5556] 20160909 Add Hw version By  Edwin
config ARIMA_HW_VERSION
	bool "Hardware Version"
	help
	  Show hardware version at proc/
# ----- [Arima 5556] 20160909 Add Hw version By  Edwin
```

## kernel-3.18/drivers/misc/mediatek/alsps/mn27913/Kconfig
```kconfig
config MTK_MN27913
	bool "epl25905 for MediaTek package"
	default n
	help
	It support different type sensor
	in this platform. If this option
	is set, it will support ambient
	and light sensor MN27913.
```

## kernel-3.18/drivers/misc/mediatek/itson/arm64/Kconfig
```kconfig
config ITSON
	bool CONFIG_ITSON_KERNEL
	default y
	help
	  Enable Itson for LG request from Telefonica
```
